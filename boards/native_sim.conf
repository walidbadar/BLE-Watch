## boards/nrf52840dk_nrf52840.conf
```kconfig
# configurations for SSD1306 display
CONFIG_SSD1306_REVERSE_MODE=y
CONFIG_LV_Z_MEM_POOL_NUMBER_BLOCKS=8

# configurations for LVGL
CONFIG_LV_MEM_CUSTOM=y
CONFIG_LV_USE_LOG=y
CONFIG_LV_USE_LABEL=y
CONFIG_LV_USE_BTN=y
CONFIG_LV_USE_IMG=y

CONFIG_NCS_SAMPLES_DEFAULTS=y
```
